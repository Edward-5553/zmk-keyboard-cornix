## boards/jzf/cornix/Kconfig.defconfig
```kconfig
# cornix board configuration

# Copyright (c) 2020 The ZMK Contributors
# SPDX-License-Identifier: MIT

## Main device (left side)
if BOARD_CORNIX_LEFT

config ZMK_KEYBOARD_NAME
	default "Cornix"

if USB

config USB_NRFX
    default y

config USB_DEVICE_STACK
    default y

endif # USB
config ZMK_SPLIT_ROLE_CENTRAL
    default y

config ZMK_SPLIT_BLE_ROLE_CENTRAL
	default y

config ZMK_SPLIT_BLE_CENTRAL_BATTERY_LEVEL_FETCHING
	default y

config ZMK_SPLIT_BLE_CENTRAL_BATTERY_LEVEL_PROXY
	default y

endif # BOARD_CORNIX_LEFT

## Peripheral device (right side)
if BOARD_CORNIX_RIGHT || BOARD_CORNIX_PH_LEFT

config ZMK_SPLIT_ROLE_CENTRAL
    default n

config ZMK_SPLIT_BLE_ROLE_CENTRAL
	default n

endif # BOARD_CORNIX_RIGHT

# Common options for both sides
if BOARD_CORNIX_LEFT  || BOARD_CORNIX_PH_LEFT || BOARD_CORNIX_RIGHT

# Keep the standard central left half and both peripheral roles consistent.
config ZMK_KSCAN_DEBOUNCE_PRESS_MS
    default 3
config ZMK_KSCAN_DEBOUNCE_RELEASE_MS
    default 3

# Battery-powered halves may sleep; reset firmware should stay awake.
if !ZMK_SETTINGS_RESET_ON_START

config ZMK_SLEEP
    default y

config ZMK_IDLE_SLEEP_TIMEOUT
    default 900000

endif # !ZMK_SETTINGS_RESET_ON_START


#config BT_CTLR
#    default BT

config BOARD_CORNIX_CHARGER
    default y

config ZMK_SPLIT
	default y

config ZMK_BLE
	default y

## disable rgb by default
config ZMK_RGB_UNDERGLOW
	default n
config ZMK_RGB_UNDERGLOW_EXT_POWER
	default n
    

endif # BOARD_CORNIX_LEFT || BOARD_CORNIX_RIGHT
# vim: set ft=kconfig:
```

## boards/shields/cornix_dongle_display/Kconfig.defconfig
```kconfig
# Copyright (c) 2024 The ZMK Contributors
# SPDX-License-Identifier: MIT

if SHIELD_CORNIX_DONGLE_DISPLAY

choice ZMK_DISPLAY_STATUS_SCREEN
    default ZMK_DISPLAY_STATUS_SCREEN_CUSTOM
endchoice

config ZMK_DISPLAY_STATUS_SCREEN_CUSTOM
    select LV_USE_LABEL
    select LV_USE_IMAGE
    select LV_USE_CANVAS
    select LV_USE_ANIMIMG
    select LV_USE_ANIMATION
    select LV_USE_LINE
    select LV_FONT_UNSCII_8

config ZMK_DONGLE_DISPLAY_DONGLE_BATTERY
    bool "Show also the battery level of the dongle"
    depends on BT && (!ZMK_SPLIT_BLE || ZMK_SPLIT_ROLE_CENTRAL)

config ZMK_DONGLE_DISPLAY_MAC_MODIFIERS
    bool "Use MacOS modifier symbols instead of the Windows symbols"

config ZMK_DONGLE_DISPLAY_BONGO_CAT
    bool "Display the Salary Cat widget"
    default y

config ZMK_DONGLE_DISPLAY_MODIFIERS
    bool "Replace the layer footer with legacy modifier/lock indicators"
    default n
    imply ZMK_HID_INDICATORS

config ZMK_DONGLE_DISPLAY_LAYER
    bool "Display the highest layer widget"
    default y

config ZMK_DONGLE_DISPLAY_LAYER_NAME_SCROLL_WIDTH
    int "Width for layer name label (in pixels)"
    default 60
    help
        Width in pixels for the layer name label. When the layer name
        exceeds this width, it will scroll horizontally in a circular pattern.

config ZMK_DONGLE_DISPLAY_LAYER_TEXT_ALIGN
    string "Layer name text alignment"
    default "center"
    help
        Text alignment for the layer name label. Valid values: "left", "center", "right".

config ZMK_DONGLE_DISPLAY_WPM
    bool "Display the WPM widget"
    default n
    select ZMK_WPM

config ZMK_DONGLE_DISPLAY_WPM_DISABLED_LAYERS
    string "Layers in which the widget is disabled, comma separated"
    default ""

choice ZMK_DISPLAY_WORK_QUEUE
    default ZMK_DISPLAY_WORK_QUEUE_DEDICATED
endchoice

config LV_Z_MEM_POOL_SIZE
    default 16384

config LV_Z_VDB_SIZE
    default 100

config LV_DPI_DEF
    default 148

config LV_Z_BITS_PER_PIXEL
    default 1

choice LV_COLOR_DEPTH
    default LV_COLOR_DEPTH_1
endchoice

endif
```

## boards/shields/cornix_dongle_display/Kconfig.shield
```kconfig
# Copyright (c) 2024 The ZMK Contributors
# SPDX-License-Identifier: MIT

config SHIELD_CORNIX_DONGLE_DISPLAY
	def_bool $(shields_list_contains,cornix_dongle_display)
```

## ports/stopwatch/main/Kconfig.projbuild
```kconfig
menu "Cornix StopWatch display"
config STOPWATCH_DISPLAY
    bool "Enable StopWatch round display"
    default y
    select LV_FONT_MONTSERRAT_14
    select LV_FONT_MONTSERRAT_28
    select LV_USE_LABEL
    select LV_USE_IMAGE
    help
        Display runs independently of BLE and USB. Disable for a headless comparison.
config STOPWATCH_LCD_X_GAP
    int "CO5300 horizontal RAM offset"
    range 0 14
    default 6
config STOPWATCH_LCD_CLOCK_MHZ
    int "QSPI clock (MHz)"
    range 10 80
    default 40
config STOPWATCH_ORIENTATION
    bool "Gravity-aligned display (experimental)"
    depends on STOPWATCH_DISPLAY && SPIRAM
    default y
config STOPWATCH_ORIENTATION_OFFSET
    int "Mounting correction in degrees"
    range -180 180
    default 0
config STOPWATCH_ORIENTATION_INVERT_X
    bool "Invert IMU screen X axis (mounting calibration)"
    default n
config STOPWATCH_ORIENTATION_INVERT_Y
    bool "Invert IMU screen Y axis (mounting calibration)"
    default n
endmenu
```

## ports/stopwatch/sdkconfig.defaults
```kconfig
CONFIG_IDF_TARGET="esp32s3"
CONFIG_ESPTOOLPY_FLASHSIZE_16MB=y
CONFIG_PARTITION_TABLE_CUSTOM=y
CONFIG_PARTITION_TABLE_CUSTOM_FILENAME="partitions.csv"
CONFIG_BT_ENABLED=y
CONFIG_BT_NIMBLE_ENABLED=y
CONFIG_BT_NIMBLE_ROLE_CENTRAL=y
CONFIG_BT_NIMBLE_ROLE_PERIPHERAL=n
CONFIG_BT_NIMBLE_ROLE_BROADCASTER=n
CONFIG_BT_NIMBLE_MAX_CONNECTIONS=2
CONFIG_BT_NIMBLE_MAX_BONDS=2
CONFIG_BT_NIMBLE_NVS_PERSIST=y
CONFIG_BT_NIMBLE_SECURITY_ENABLE=y
CONFIG_BT_NIMBLE_SM_SC=y
CONFIG_BT_NIMBLE_SM_LEGACY=y
CONFIG_TINYUSB_HID_COUNT=1
CONFIG_ESP_CONSOLE_UART_DEFAULT=y
CONFIG_ESP_CONSOLE_USB_SERIAL_JTAG=n
CONFIG_ESP_CONSOLE_SECONDARY_NONE=y
CONFIG_ESP_CONSOLE_SECONDARY_USB_SERIAL_JTAG=n
CONFIG_FREERTOS_HZ=1000
CONFIG_ESP_MAIN_TASK_STACK_SIZE=16384

# Gravity rotation framebuffer; keep general allocations in internal RAM.
CONFIG_SPIRAM=y
CONFIG_SPIRAM_MODE_OCT=y
CONFIG_SPIRAM_SPEED_40M=y
CONFIG_SPIRAM_USE_CAPS_ALLOC=y
CONFIG_SPIRAM_IGNORE_NOTFOUND=y
```
